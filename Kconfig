## Kconfig
```kconfig
mainmenu "ESP8266 thing configuration"

config	THING_NAME
	string
	default "Actuator" if THING_ACTUATOR='y'
	default "Thermometer" if THING_THERMOMETER_DS18B20='y'

choice
	prompt "Thing type"
	default THING_ACTUATOR

config THING_ACTUATOR
	tristate "Actuator thing"

config THING_THERMOMETER_DS18B20
	tristate "Thermometer thing with DS18b20"
endchoice

source "thing/Kconfig"
```

## thing/Kconfig
```kconfig
menu "SPI settings"

config SMING_DISABLE_SPIFFS
	string
	default "0" if SPIFFS_SUPPORT='y'
	default "1" if SPIFFS_SUPPORT='n'

config SPIFFS_SUPPORT
	bool "SPI flash file system (spiffs) support"

config SMING_SPI_SIZE
	string
	default "1M" if SPI_SIZE_1MIB='y'
	default "4M" if SPI_SIZE_4MIB='y'

choice
	prompt "Flash size"
	default SPI_SIZE_1MIB

config SPI_SIZE_1MIB
	bool "1 MiB"

config SPI_SIZE_4MIB
	bool "4 MiB"
endchoice

config SMING_SPI_SPEED
	string
	default "20" if SPI_SPEED_20MHZ='y'
	default "26" if SPI_SPEED_26_7MHZ='y'
	default "40" if SPI_SPEED_40MHZ='y'
	default "80" if SPI_SPEED_80MHZ='y'

choice
	prompt "Speed"
	default SPI_SPEED_40MHZ

config SPI_SPEED_20MHZ
	bool "20 MHz"

config SPI_SPEED_26_7MHZ
	bool "26.7 MHz"

config SPI_SPEED_40MHZ
	bool "40 MHz"

config SPI_SPEED_80MHZ
	bool "80 MHz"
endchoice

config SMING_SPI_MODE
	string
	default "qio"  if SPI_MODE_QIO ='y'
	default "qout" if SPI_MODE_QOUT='y'
	default "dio"  if SPI_MODE_DIO ='y'
	default "dout" if SPI_MODE_DOUT='y'

choice
	prompt "Mode"
	default SPI_MODE_QIO

config SPI_MODE_QIO
	bool "Quad I/O: 4 pins used for address & data. Fastest."

config SPI_MODE_DIO
	bool "Dual I/O: 2 pins used for address & data. Approx 45% slower than qio."

config SPI_MODE_QOUT
	bool "Quad Output: 4 pins used for data. Approx 15% slower than qio."

config SPI_MODE_DOUT
	bool "Dual Output: 2 pins used for data. Approx 50% slower than qio."
endchoice

endmenu

menu "WiFi settings"
config WIFI_SSID
	string "WiFi SSID"

config WIFI_PWD
	string "WiFi password"
endmenu

menu "RBoot OTA settings"

config SMING_RBOOT_ENABLED
	int
	default 1

config SMING_RBOOT_BIG_FLASH
	int
	default 1
	depends on SPI_SIZE_4MIB='y'

config	SMING_RBOOT_TWO_ROMS
	int
	default 1

config	SMING_RBOOT_ROM_0
	string "First ROM binary name"
	default "rom0"

config	SMING_RBOOT_ROM_1
	string "Second ROM binary name"
	default "rom1"

config	SMING_RBOOT_LD_0
	string "Linker file for the first ROM"
	default "rom0.ld"

config	SMING_RBOOT_LD_1
	string "Linker file for the second ROM"
	default "rom1.ld"

config RBOOT_OTA_HOST
	string "rboot OTA host"

config RBOOT_OTA_PORT
	int "rboot OTA port"
	default "80"
endmenu

menu "MQTT settings"
config MQTT_USER
	string "MQTT user ID"

config MQTT_PWD
	string "MQTT password"

config MQTT_HOST
	string "MQTT host"

config MQTT_PORT
	int "MQTT port"
	default "1883"
endmenu

menu "Host serial port settings"
config	SMING_COM_PORT
	string "Serial port"
	default "/dev/ttyUSB0"

config	SMING_COM_SPEED
	int "Serial port speed"
	default 115200
endmenu

config DEBUG
	bool "Enable log functions"
	default y
	help
	  Say Y if you want to enable logging.
	  If you say N here, logging is not compiled.
```
